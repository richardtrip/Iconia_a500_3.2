## drivers/switch/Kconfig
```kconfig
menuconfig SWITCH
	tristate "Switch class support"
	help
	  Say Y here to enable switch class support. This allows
	  monitoring switches by userspace via sysfs and uevent.

if SWITCH

config SWITCH_GPIO
	tristate "GPIO Swith support"
	depends on GENERIC_GPIO
	help
	  Say Y here to enable GPIO based switch support.

endif # SWITCH

config DOCK
	tristate "Dock Swith support"
	default n

config ROTATELOCK
	tristate "RotationLock Switch support"
	default n

config PSENSOR
	tristate "P-Sensor Switch support"
	default n

config SIMDETECT
        tristate "SIM Hot-plug detection support"
        default n
```
